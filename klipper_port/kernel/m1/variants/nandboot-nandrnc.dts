// SPDX-License-Identifier: GPL-2.0
/*
 * m1-nandboot-nandrnc: nanddbg's reserved areas, with ramoops keeping only
 * its dmesg records (written on a panic or oops): no console or pmsg zone,
 * so nothing writes the area while the system runs.
 */
#include "nandboot-nanddbg.dts"

&{/reserved-memory/ramoops@1e000000} {
	console-size = <0>;
	pmsg-size = <0>;
};
