## kernel/m1/src/arch/arm/mach-mv61x0/Kconfig
```kconfig
# SPDX-License-Identifier: GPL-2.0-only
config ARCH_MV61X0
	bool "Marvell 88PA61x0 printer SoCs"
	depends on ARCH_MULTI_V7
	select ARM_GIC
	select ARM_HEAVY_MB
	select CPU_PJ4B
	select HAVE_ARM_SCU if SMP
	select HAVE_ARM_TWD if SMP
	select MV61X0_SIC
	select MV61X0_TIMER
	select PHY_MV61X0_USB if USB_SUPPORT
	help
	  Support for the Marvell 88PA6170 SoC of the Sindoh DP200 3D
	  printer: two PJ4B-MP cores with an A9-style SCU and GIC.

config MV61X0_LAYOUT_PAD
	bool "DP200 hang analysis: zero padding in fs/ and lib/"
	depends on ARCH_MV61X0
	help
	  Zero-filled .text, .rodata, .data, .bss and .init.text, linked
	  where fs/pstore/ and lib/reed_solomon/ would be, so that a kernel
	  without pstore gets the addresses of one with it. Nothing reads or
	  runs the padding. Test option (docs/kernel/nandboot_hang_analysis.md,
	  hang 24).

if MV61X0_LAYOUT_PAD
config MV61X0_PAD_FS_TEXT
	hex "fs/ .text bytes"
	default 0x0
config MV61X0_PAD_FS_TEXT_UNLIKELY
	hex "fs/ .text.unlikely bytes"
	default 0x0
config MV61X0_PAD_FS_RODATA
	hex "fs/ .rodata bytes"
	default 0x0
config MV61X0_PAD_FS_RODATA_STR
	hex "fs/ merged-string bytes (at least 1)"
	default 0x1
config MV61X0_PAD_FS_RANDOM
	hex "fs/ incompressible .rodata bytes (a multiple of 4)"
	default 0x0
config MV61X0_PAD_FS_DATA
	hex "fs/ .data bytes"
	default 0x0
config MV61X0_PAD_FS_BSS
	hex "fs/ .bss bytes"
	default 0x0
config MV61X0_PAD_FS_INIT_TEXT
	hex "fs/ .init.text bytes"
	default 0x0
config MV61X0_PAD_LIB_TEXT
	hex "lib/ .text bytes"
	default 0x0
config MV61X0_PAD_LIB_RODATA
	hex "lib/ .rodata bytes"
	default 0x0
config MV61X0_PAD_LIB_DATA
	hex "lib/ .data bytes"
	default 0x0
config MV61X0_PAD_LIB_BSS
	hex "lib/ .bss bytes"
	default 0x0
endif

config MV61X0_FORCE_REED_SOLOMON
	bool "DP200 hang analysis: build Reed-Solomon in without a user"
	depends on ARCH_MV61X0
	select REED_SOLOMON
	select REED_SOLOMON_ENC8
	select REED_SOLOMON_DEC8
	help
	  The library PSTORE_RAM selects, on its own (no pstore). Test option
	  (docs/kernel/nandboot_hang_analysis.md, hang 25).

config MV61X0_RAMOOPS_NO_INIT
	bool "DP200 hang analysis: ramoops_init returns at once"
	depends on ARCH_MV61X0 && PSTORE_RAM=y
	help
	  PSTORE_RAM built in, but ramoops_init neither registers the dummy
	  device nor the platform driver. Test option
	  (docs/kernel/nandboot_hang_analysis.md, hang 25).

config MV61X0_DUMMY_PDRV
	bool "DP200 hang analysis: register a platform driver that binds nothing"
	depends on ARCH_MV61X0
	help
	  A platform driver with an OF match table nothing matches,
	  registered at postcore_initcall as ramoops_init does. Tells whether
	  any such registration speeds up the two-CPU freeze, or only
	  ramoops'. Test option (docs/kernel/nandboot_hang_analysis.md,
	  hang 25 / nandps4).

config MV61X0_DUMMY_PDRV_AS_RAMOOPS
	bool "DP200 hang analysis: the dummy driver as \"ramoops\""
	depends on MV61X0_DUMMY_PDRV && !PSTORE_RAM
	help
	  The dummy platform driver takes ramoops' driver name and OF match
	  string, and logs at KERN_EMERG if its probe is ever called.
```

## klipper/src/upc/Kconfig
```kconfig
# Kconfig settings for the Marvell 88PA6170 UPC cores (Sindoh DP200)

if MACH_UPC

config UPC_SELECT
    bool
    default y
    select HAVE_GPIO
    select HAVE_GPIO_ADC if UPC_CORE_IO
    select HAVE_GPIO_HARD_PWM
    select HAVE_LIMITED_CODE_SIZE
    select SERIAL

config BOARD_DIRECTORY
    string
    default "upc"

choice
    prompt "UPC core"
    config UPC_CORE_FM
        bool "FM core (/dev/upc1) - steppers, endstops, motor current"
    config UPC_CORE_IO
        bool "IO core (/dev/upc0) - heaters, fans, thermistors"
endchoice

config MCU
    string
    default "upc_fm" if UPC_CORE_FM
    default "upc_io"

config CLOCK_FREQ
    int "Timer frequency in Hz"
    default 396000000
    help
      XENA Timer1 measured on the printer at 395.76-395.85 MHz
      (2 x the 198 MHz dithered bus clock). Klipper's clock sync
      corrects the small remaining offset.

config UPC_TIMER_ADDR
    hex "One-shot down-counter used as timebase (XENA Timer1)"
    default 0x08001144

config UPC_THUMB
    bool "Compile in Thumb mode (needed to fit 16 KiB; verified on hardware)"
    default y

config UPC_ITCM_SIZE
    hex "ITCM size in bytes (upc.ko only accepts 0x4000)"
    default 0x4000

config UPC_DYNMEM_SIZE
    int "Bytes of DTCM for move queues and other dynamic objects"
    default 16384

config UPC_STEP_HALF_TICKS
    int "Step pulse half period in stepper-engine ticks (200 MHz)"
    default 400
    help
      Each step is issued as a one-pulse hardware move: the STEP line is
      high for this many 5 ns ticks, then low for the same time. 400 =
      2 us high, comfortably above the A4982's 1 us minimum.

config UPC_STEP_SINGLE
    bool "One timer event per step (no unstep events)"
    depends on UPC_CORE_FM
    default n
    help
      The stepper engine makes the whole STEP pulse in hardware, so the
      "unstep" timer event of Klipper's step/unstep path does nothing but
      cost an interrupt. With this, the stepper code runs one event per
      step (its single-schedule mode, as for "step on both edges") and
      every STEP pin toggle starts one engine pulse. The host's step
      timing is unchanged. Halves the step interrupts.

config UPC_STEP_BATCH
    bool "Run constant-rate step blocks as multi-step engine moves"
    depends on UPC_CORE_FM
    select UPC_STEP_SINGLE
    default n
    help
      A queue_step block with add == 0 is handed to the stepper engine
      as one move (its rising edges on the scheduled step times) instead
      of one timer event per step. Positions mid-move and after a homing
      stop come from the engine's edge counter (+0x78).

config UPC_STEP_BATCH_MIN
    int "Fewest steps in a block for an engine move"
    depends on UPC_STEP_BATCH
    default 8

config UPC_STEP_BATCH_ERR
    int "Most timer ticks an engine move's last step may come early"
    depends on UPC_STEP_BATCH
    default 400
    help
      The engine's edge period is the step interval / 4 (engine ticks);
      the remainder makes each step up to 3 timer ticks early. Longer
      blocks are split so this stays below the limit (400 = 1 us).

config UPC_ADC_SETTLE_US
    int "Wait after selecting an ADC input before reading (microseconds)"
    depends on UPC_CORE_IO
    default 10000

endif
```

## klipper_port/kernel/m1/src/arch/arm/mach-mv61x0/Kconfig
```kconfig
# SPDX-License-Identifier: GPL-2.0-only
config ARCH_MV61X0
	bool "Marvell 88PA61x0 printer SoCs"
	depends on ARCH_MULTI_V7
	select ARM_GIC
	select ARM_HEAVY_MB
	select CPU_PJ4B
	select HAVE_ARM_SCU if SMP
	select HAVE_ARM_TWD if SMP
	select MV61X0_SIC
	select MV61X0_TIMER
	select PHY_MV61X0_USB if USB_SUPPORT
	help
	  Support for the Marvell 88PA6170 SoC of the Sindoh DP200 3D
	  printer: two PJ4B-MP cores with an A9-style SCU and GIC.

config MV61X0_LAYOUT_PAD
	bool "DP200 hang analysis: zero padding in fs/ and lib/"
	depends on ARCH_MV61X0
	help
	  Zero-filled .text, .rodata, .data, .bss and .init.text, linked
	  where fs/pstore/ and lib/reed_solomon/ would be, so that a kernel
	  without pstore gets the addresses of one with it. Nothing reads or
	  runs the padding. Test option (docs/kernel/nandboot_hang_analysis.md,
	  hang 24).

if MV61X0_LAYOUT_PAD
config MV61X0_PAD_FS_TEXT
	hex "fs/ .text bytes"
	default 0x0
config MV61X0_PAD_FS_TEXT_UNLIKELY
	hex "fs/ .text.unlikely bytes"
	default 0x0
config MV61X0_PAD_FS_RODATA
	hex "fs/ .rodata bytes"
	default 0x0
config MV61X0_PAD_FS_RODATA_STR
	hex "fs/ merged-string bytes (at least 1)"
	default 0x1
config MV61X0_PAD_FS_RANDOM
	hex "fs/ incompressible .rodata bytes (a multiple of 4)"
	default 0x0
config MV61X0_PAD_FS_DATA
	hex "fs/ .data bytes"
	default 0x0
config MV61X0_PAD_FS_BSS
	hex "fs/ .bss bytes"
	default 0x0
config MV61X0_PAD_FS_INIT_TEXT
	hex "fs/ .init.text bytes"
	default 0x0
config MV61X0_PAD_LIB_TEXT
	hex "lib/ .text bytes"
	default 0x0
config MV61X0_PAD_LIB_RODATA
	hex "lib/ .rodata bytes"
	default 0x0
config MV61X0_PAD_LIB_DATA
	hex "lib/ .data bytes"
	default 0x0
config MV61X0_PAD_LIB_BSS
	hex "lib/ .bss bytes"
	default 0x0
endif
```
